//Thư viện TFT LCD
#include <Adafruit_GFX.h>    // Core graphics library
#include <Adafruit_ST7789.h> // Hardware-specific library for ST7789
#include <SPI.h>
//------------Định nghĩa các chân LCD---------------
#define TFT_CS         15
#define TFT_RST        5
#define TFT_DC         18
// Use dedicated hardware SPI pins
#define TFT_MOSI 13  // Data out
#define TFT_SCLK 14  // Clock out
//------------Mode 2.4 inch (240x320)------------
Adafruit_ST7789 tft = Adafruit_ST7789(TFT_CS, TFT_DC, TFT_MOSI, TFT_SCLK, TFT_RST);

//Thư viện cho DS1307
#include "RTClib.h"
TimerHandle_t timer;
RTC_DS1307 rtc; //Khởi tạo một đối tượng của thư viện RTClib là rtc
char daysOfTheWeek[7][12] = {"Sunday", "Monday", "Tuesday", "Wednesday","Thursday", "Friday", "Saturday"};
//-------------Định nghĩa màu sắc------------
#define BLACK 0x0000    
#define BLUE 0x001F    
#define RED 0xF800      
#define GREEN 0x07E0
#define CYAN 0x07FF
#define MAGENTA 0xF81F  
#define YELLOW 0xFFE0
#define WHITE 0xFFFF 
#define DARK_GREEN 0x2AE1

//-------------Bitmap Logo cho TFT LCD------------------
const unsigned short LOGO[2565] PROGMEM={
0xFFFF, 0xFFFF, 0xFFFF, 0xFFFF, 0xFFFF, 0xFFFF, 0xFFFF, 0xFFFF, 0xFFFF, 0xFFFF, 0xFFFF, 0xFFFF, 0xFFFF, 0xFFFF, 0xFFFF, 0xEF5D,   // 0x0010 (16) pixels
0xD69B, 0xC61C, 0xBDDB, 0xB599, 0xB578, 0xB578, 0xAD37, 0xAD58, 0xAD78, 0xB5BA, 0xBDDB, 0xC63C, 0xD6BB, 0xEF5D, 0xFFFF, 0xFFFF,   // 0x0020 (32) pixels
0xFFFF, 0xFFFF, 0xFFFF, 0xFFFF, 0xFFFF, 0xFFFF, 0xFFFF, 0xFFFF, 0xFFFF, 0xFFFF, 0xFFFF, 0xFFFF, 0xFFFF, 0xFFFF, 0xFFFF, 0xFFFF,   // 0x0030 (48) pixels
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0xFFFF, 0xDEFD, 0x6B57, 0x2931, 0x2951, 0x73B6, 0xE73D, 0xFFFF, 0xFFFF, 0xCE5C, 0x5295, 0x6B36, 0xEF5E, 0xFFFF, 0xFFDF, 0x8C38   // 0x0A00 (2560) pixels
};

const unsigned short PIN[625] PROGMEM={
0xFFFF, 0xFFFF, 0xFFFF, 0xFFFF, 0xFFFF, 0xFFFF, 0xFFFF, 0xFFFF, 0xFFFF, 0xFFFF, 0xFFFF, 0xFFFF, 0xFFFF, 0xFFFF, 0xFFFF, 0xFFFF,   // 0x0010 (16) pixels
0xFFFF, 0xFFFF, 0xFFFF, 0xFFFF, 0xFFFF, 0xFFFF, 0xFFFF, 0xFFFF, 0xFFFF, 0xFFFF, 0xFFFF, 0xFFFF, 0xFFFF, 0xFFFF, 0xFFFF, 0xFFFF,   // 0x0020 (32) pixels
0xFFFF, 0xFFFF, 0xFFFF, 0xFFFF, 0xFFFF, 0xFFFF, 0xFFFF, 0xFFFF, 0xFFFF, 0xFFFF, 0xFFFF, 0xFFFF, 0xFFFF, 0xFFFF, 0xFFFF, 0xFFFF,   // 0x0030 (48) pixels
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0xFFFF, 0xFFFF, 0xFFFF, 0xFFFF, 0xFFFF, 0xFFFF, 0xFFFF, 0xFFFF, 0xFFFF, 0xFFFF, 0xFFFF, 0xFFFF, 0xFFFF, 0xFFFF, 0xFFFF, 0xFFFF   // 0x0270 (624) pixels
};

const unsigned short WAVE[625] PROGMEM={
0xFFFF, 0xFFFF, 0xFFFF, 0xFFFF, 0xFFFF, 0xFFFF, 0xFFFF, 0xFFFF, 0xFFFF, 0xFFFF, 0xFFFF, 0xFFFF, 0xFFFF, 0xFFFF, 0xFFFF, 0xFFFF,   // 0x0010 (16) pixels
0xFFFF, 0xFFFF, 0xFFFF, 0xFFFF, 0xFFFF, 0xFFFF, 0xFFFF, 0xFFFF, 0xFFFF, 0xFFFF, 0xFFFF, 0xFFFF, 0xFFFF, 0xFFFF, 0xFFFF, 0xFFFF,   // 0x0020 (32) pixels
0xFFFF, 0xFFFF, 0xFFFF, 0xFFFF, 0xFFFF, 0xFFFF, 0xFFFF, 0xFFFF, 0xFFFF, 0xFFFF, 0xFFFF, 0xFFFF, 0xFFFF, 0xFFFF, 0xFFFF, 0xFFDF,   // 0x0030 (48) pixels
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0xFFFF, 0xFFFF, 0xFFFF, 0xFFFF, 0xFFFF, 0xFFFF, 0xFFFF, 0xFFFF, 0xFFFF, 0xFFFF, 0xFFFF, 0xFFFF, 0xFFFF, 0xFFFF, 0xFFFF, 0xFFFF,   // 0x0270 (624) pixels
};

const unsigned short WIFI[650] PROGMEM={
0xFFFF, 0xFFFF, 0xFFFF, 0xFFFF, 0xFFFF, 0xFFFF, 0xFFFF, 0xFFFF, 0xFFFF, 0xFFFF, 0xFFFF, 0xFFFF, 0xFFFF, 0xFFFF, 0xFFFF, 0xFFFF,   // 0x0010 (16) pixels
0xFFFF, 0xFFFF, 0xFFFF, 0xFFFF, 0xFFFF, 0xFFFF, 0xFFFF, 0xFFFF, 0xFFFF, 0xFFFF, 0xFFFF, 0xFFFF, 0xFFFF, 0xFFFF, 0xFFFF, 0xFFFF,   // 0x0020 (32) pixels
0xFFFF, 0xFFFF, 0xFFFF, 0xFFFF, 0xFFFF, 0xFFFF, 0xFFFF, 0xFFFF, 0xFFFF, 0xFFFF, 0xFFFF, 0xFFFF, 0xFFFF, 0xFFFF, 0xFFFF, 0xFFFF,   // 0x0030 (48) pixels
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0xFFFF, 0xFFFF, 0xFFFF, 0xFFFF, 0xFFFF, 0xFFFF, 0xFFFF, 0xFFFF, 0xFFFF, 0xFFFF, 0xFFFF, 0xFFFF, 0xFFFF, 0xFFFF, 0xFFFF, 0xFFFF,   // 0x0270 (624) pixels
};

const unsigned short SETTING[1600] PROGMEM={
0xFFFF, 0xFFFF, 0xFFFF, 0xFFFF, 0xFFFF, 0xFFFF, 0xFFFF, 0xFFFF, 0xFFFF, 0xFFFF, 0xFFFF, 0xFFFF, 0xFFFF, 0xFFFF, 0xE73C, 0x0041,   // 0x0010 (16) pixels
0x0041, 0x31C7, 0x31A7, 0x4A6A, 0x4249, 0x31A7, 0x4A6A, 0x0841, 0x0841, 0xE73C, 0xFFFF, 0xFFFF, 0xFFFF, 0xFFFF, 0xFFFF, 0xFFFF,   // 0x0020 (32) pixels
0xFFFF, 0xFFFF, 0xFFFF, 0xFFFF, 0xFFFF, 0xFFFF, 0xFFFF, 0xFFFF, 0xFFFF, 0xFFFF, 0xFFFF, 0xFFFF, 0xFFFF, 0xFFFF, 0xFFFF, 0xFFFF,   // 0x0030 (48) pixels
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0x0020, 0x18E3, 0xFFFF, 0xFFFF, 0xFFFF, 0xFFFF, 0xFFFF, 0xFFFF, 0xFFFF, 0xFFFF, 0xFFFF, 0xFFFF, 0xFFFF, 0xFFFF, 0xFFFF, 0xFFFF   // 0x0640 (1600) pixels
};

const unsigned short spotify[1600] PROGMEM={
0xFFFF, 0xFFFF, 0xFFFF, 0xFFFF, 0xFFFF, 0xFFFF, 0xFFFF, 0xFFFF, 0xFFFF, 0xFFFF, 0xFFFF, 0xFFFF, 0xFFFF, 0xFFFF, 0x8C71, 0x18C3,   // 0x0010 (16) pixels
0x0729, 0x0729, 0x07EA, 0x07EA, 0x07EA, 0x07EA, 0x0729, 0x0729, 0x18C3, 0xEF5D, 0xFFFF, 0xFFFF, 0xFFFF, 0xFFFF, 0xFFFF, 0xFFFF,   // 0x0020 (32) pixels
0xFFFF, 0xFFFF, 0xFFFF, 0xFFFF, 0xFFFF, 0xFFFF, 0xFFFF, 0xFFFF, 0xFFFF, 0xFFFF, 0xFFFF, 0xFFFF, 0xFFFF, 0xFFFF, 0xFFFF, 0xFFFF,   // 0x0030 (48) pixels
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0x8410, 0xFFFF, 0xFFFF, 0xFFFF, 0xFFFF, 0xFFFF, 0xFFFF, 0xFFFF, 0xFFFF, 0xFFFF, 0xFFFF, 0xFFFF, 0xFFFF, 0xFFFF, 0xFFFF, 0xFFFF  // 0x0640 (1600) pixels
};

const unsigned short sk[1600] PROGMEM={
0xFFFF, 0xFFFF, 0xFFFF, 0xFFFF, 0xFFFF, 0xFFFF, 0xFFFF, 0xFFFF, 0xFFFF, 0xFFFF, 0xFFFF, 0xFFFF, 0xFFFF, 0xFFFF, 0xFFFF, 0xFFFF,   // 0x0010 (16) pixels
0xFFFF, 0xFFFF, 0xFFFF, 0xFFFF, 0xFFFF, 0xF79E, 0x10C1, 0x97E0, 0x97E0, 0x10C0, 0xF79E, 0xFFFF, 0xFFFF, 0xFFFF, 0xFFFF, 0xFFFF,   // 0x0020 (32) pixels
0xFFFF, 0xFFFF, 0xFFFF, 0xFFFF, 0xFFFF, 0xFFFF, 0xFFFF, 0xFFFF, 0xFFFF, 0xFFFF, 0xFFFF, 0xFFFF, 0xFFFF, 0xFFFF, 0xFFFF, 0xFFFF,   // 0x0030 (48) pixels
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0xFFFF, 0xFFFF, 0xFFFF, 0xFFFF, 0xFFFF, 0xFFFF, 0xFFFF, 0xFFFF, 0xFFFF, 0xFFFF, 0xFFFF, 0xFFFF, 0xFFFF, 0xFFFF, 0xFFFF, 0xFFFF   // 0x0640 (1600) pixels
};

const unsigned short traitim[1600] PROGMEM={
0xFFFF, 0xFFFF, 0xFFFF, 0xFFFF, 0xFFFF, 0xFFFF, 0xFFFF, 0xFFFF, 0xFFFF, 0xFFFF, 0xFFFF, 0xFFFF, 0xFFFF, 0xFFFF, 0xFFFF, 0xFFFF,   // 0x0010 (16) pixels
0xFFFF, 0xFFFF, 0xFFFF, 0xFFFF, 0xFFFF, 0xFFFF, 0xFFFF, 0xFFFF, 0xFFFF, 0xFFFF, 0x738E, 0x0000, 0x0000, 0x0000, 0x0000, 0x0000,   // 0x0020 (32) pixels
0xE73C, 0xFFFF, 0xFFFF, 0xFFFF, 0xFFFF, 0xFFFF, 0xFFFF, 0xFFFF, 0xFFFF, 0xFFFF, 0xFFFF, 0xFFFF, 0xFFFF, 0xFFFF, 0xFFFF, 0xFFFF,   // 0x0030 (48) pixels
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0xFFFF, 0xFFFF, 0xFFFF, 0xFFFF, 0xFFFF, 0xFFFF, 0xFFFF, 0xFFFF, 0xFFFF, 0xFFFF, 0xFFFF, 0xFFFF, 0xFFFF, 0xFFFF, 0xFFFF, 0xFFFF   // 0x0640 (1600) pixels
};

//===================Phan chuong trinh con=====================
void printText(char *text, uint16_t color, int x, int y,int textSize ){
  tft.setCursor(x, y);
  tft.setTextColor(color);
  tft.setTextSize(textSize);
  tft.print(text);
}



void setup() {
  Serial.begin(9600);
  xTaskCreate((TaskFunction_t)&Task_CLOCK, "Task", 4000, NULL,1,NULL);
  timer = xTimerCreate("Software Timer", pdMS_TO_TICKS(1000),pdTRUE,0, (TimerCallbackFunction_t)Task_timer);
  if (timer == NULL)
  {
    Serial.println("Failed to create timer");
  }
  if (xTimerStart(timer,0) != pdPASS)
  {
    Serial.println("Failed to start timer");
  }
  //setup_TFT();
}

void loop() {
  // put your main code here, to run repeatedly:

}


void setup_DS1307()
{
  if (! rtc.begin()) //Kiểm tra xem module RTC có được kết nối hay không
 {
   Serial.print("Couldn't find RTC"); //Nếu không thì in ra thông báo "Couldn't find RTC" và dừng chương trình
   Serial.flush();
   while (1)  delay(10); 
 }
  if (! rtc.isrunning()) //Kiểm tra xem module RTC có đang hoạt động hay không (đọc các thanh ghi bên trong I2C của DS1307 để kiểm tra xem chip có trả về thời gian hay không)
 {
   Serial.print("RTC is NOT running!"); //Nếu không hoạt động, in ra thông báo "RTC is NOT running!" và tiếp tục chương trình
   Serial.println(); 
 }
   rtc.adjust(DateTime(F(__DATE__), F(__TIME__))); //Cập nhật thời gian tự động từ máy tính
   //rtc.adjust(DateTime(2014, 1, 21, 3, 0, 0));
}


void Task_timer()
{
  setup_DS1307();
  while(1)
  {
   if (Serial.available() > 0) {
    // Nếu có dữ liệu từ Serial, đọc giờ từ Serial và cập nhật RTC
    int day = Serial.parseInt();
    int month = Serial.parseInt();
    int year = Serial.parseInt();
    int hour = Serial.parseInt();
    int minute = Serial.parseInt();
    int second = Serial.parseInt();

    
    // Chờ đến khi kết thúc dữ liệu được truyền vào
    while (Serial.available() > 0) {
      Serial.read();
      tft.fillRect(40,130, 180, 120, WHITE);
    }

    // Cập nhật thời gian trên module RTC
    rtc.adjust(DateTime(year, month, day, hour, minute, second));
  }
  DateTime now = rtc.now(); //Lấy thời gian hiện tại từ module RTC và lưu vào biến now
  Serial.print(now.year()); //In ra năm hiện tại từ đối tượng now của lớp DateTime
  Serial.print('/');       //In ra màn hình "/"
  Serial.print(now.month()); //In ra tháng hiện tại từ đối tượng now của lớp DateTime
  Serial.print('/');          
  Serial.print(now.day());
  Serial.print(' ');
  Serial.print(daysOfTheWeek[now.dayOfTheWeek()]);
  Serial.print(" ");
  Serial.print(now.hour());
  Serial.print(':');
  Serial.print(now.minute());
  Serial.print(':');
  Serial.print(now.second());
  Serial.println();
  delay(1000); //Tạo độ trễ 1s

  }
}

void setup_TFT()
{
  
  tft.init(240, 320);                     // Init ST7789 240x135
  tft.setRotation(2);   
  tft.fillScreen(WHITE);                  //Thiet lap mau nen LCD
  Serial.println(F("Initialized"));

  printText("SMART WATCH", MAGENTA, 55, 90, 2);
  tft.drawRGBBitmap(15, 15, LOGO, 45,57);
  tft.drawRGBBitmap(200, 15, PIN, 25, 25);
  tft.drawRGBBitmap(165, 15, WAVE, 25, 25);
  tft.drawRGBBitmap(130, 15, WIFI, 25, 25);
  tft.drawRGBBitmap(20, 255, SETTING, 40, 40);
  tft.drawRGBBitmap(75, 255, spotify, 40, 40);
  tft.drawRGBBitmap(125, 255, sk, 40, 40);
  tft.drawRGBBitmap(175, 255, traitim, 40, 40);
  tft.drawRect(2,2,236,316,GREEN);
  tft.drawRect(10,10,220,300,BLUE);
}

void Task_CLOCK()
{
  setup_TFT();
  while(1){
  if (Serial.available() > 0) {
    // Nếu có dữ liệu từ Serial, đọc giờ từ Serial và cập nhật RTC
    int day = Serial.parseInt();
    int month = Serial.parseInt();
    int year = Serial.parseInt();
    int hour = Serial.parseInt();
    int minute = Serial.parseInt();
    int second = Serial.parseInt();

    
    // Chờ đến khi kết thúc dữ liệu được truyền vào
    while (Serial.available() > 0) {
      Serial.read();
      tft.fillRect(40,130, 180, 120, WHITE);
    }

    // Cập nhật thời gian trên module RTC
    rtc.adjust(DateTime(year, month, day, hour, minute, second));
    tft.fillRect(40,130, 180, 120, WHITE);
  }
  
  DateTime now = rtc.now(); //Lấy thời gian hiện tại từ module RTC và lưu vào biến now
//-------Setup vị trí màu sắc và kích thước----------
  tft.setCursor(40, 185);
  tft.setTextColor(RED);
  tft.setTextSize(3);
//--------------Day---------------
  if(now.hour()<1 && now.second()<1 && now.minute()<1 ){
    tft.fillRect(40,185, 30, 20, WHITE);
  }
  tft.print(now.day());
  tft.setCursor(70, 185);
  tft.print(":");
//-------------Month-------------
  tft.setCursor(80, 185);
  if(now.day()==1 && now.hour()<1 && now.minute()<1 && now.second()<1){
    tft.fillRect(80,185, 30, 20, WHITE);
  }
  tft.print(now.month());
  tft.setCursor(115, 185);
  tft.print(":");
//---------------Year---------------
  tft.setCursor(130, 185);
  if(now.day()==1 && now.month()==1 && now.hour()<1 && now.minute()<1){
    tft.fillRect(130,185, 60, 20, WHITE);
  }
  tft.print(now.year());
//---------------Hour----------------
  tft.setTextSize(4);
  tft.setCursor(40, 130);
  if(now.minute()<1){
    tft.fillRect(40,130, 50, 40, WHITE);
  }
  if(now.hour()<=9){
    tft.print("0");
    tft.print(now.hour());
    tft.print(" ");
  } else{
    tft.print(now.hour());
    tft.print(" ");
  }
  tft.setCursor(80, 130);
  tft.print(":");
//--------------Minute--------------
  tft.setCursor(95, 130);
  if(now.second()<=1){
    tft.fillRect(95,130, 50, 40, WHITE);
  }
  if(now.minute()<=9){
    tft.print("0");
    tft.print(now.minute());
    tft.print(" ");
  } else{
    tft.print(now.minute());
    tft.print(" ");
  }
  tft.setCursor(135, 130);
  tft.print(":");
//--------------Second----------------
  tft.setCursor(150, 130);
  tft.fillRect(150,130, 50, 40, WHITE);
  if(now.second()<=9){
    tft.print("0");
    tft.print(now.second());
    tft.print(" ");
  } else{
    tft.print(now.second());
    tft.print(" ");
  }
//--------------DayofWeek---------------
  tft.setTextSize(2);
  tft.setCursor(80,165);
  if(now.hour()<1 && now.second()<=1 && now.minute()<=1 ){
  tft.fillRect(80,165, 150, 20, WHITE);
  }
  tft.print(daysOfTheWeek[now.dayOfTheWeek()]);
  delay(1000);
  }
}



